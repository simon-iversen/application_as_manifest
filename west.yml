## west.yml
```yaml
manifest:
  remotes:
    - name: ncs
      url-base: https://github.com/nrfconnect
  projects:
    - name: nrf
      repo-path: sdk-nrf
      remote: ncs
      revision: v1.9.1
      import: 
        path-prefix: ncs_dependencies
  self:
    path: hello_world
```
